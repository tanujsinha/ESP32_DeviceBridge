## main/Kconfig
```kconfig
menu "Application Configuration"

config APP_WIFI_SUPPORT
    bool "Enable Wi-Fi Support"
    default y

config APP_WEB_UI_SUPPORT
    bool "Enable Web UI Support"
    default y

config APP_ZIGBEE_SUPPORT
    bool "Enable Zigbee Support"
    default n

endmenu
```

## sdkconfig.defaults
```kconfig
CONFIG_IDF_TARGET="esp32"
CONFIG_ESP_WIFI_ENABLED=y
CONFIG_ESP_NETIF_TCPIP_LWIP=y
CONFIG_FREERTOS_UNICORE=n
CONFIG_ESP_SYSTEM_PANIC_PRINT_REBOOT=y
CONFIG_LOG_DEFAULT_LEVEL=3
CONFIG_PARTITION_TABLE_SINGLE_APP=y
CONFIG_ESP_MAIN_TASK_STACK_SIZE=4096
CONFIG_ESP_WIFI_STA_AUTO_CONNECT=y
CONFIG_ESP_HTTP_SERVER_ENABLE=y
CONFIG_ZB_ENABLED=y
CONFIG_ESP_MATTER_BRIDGE_ZIGBEE=y
CONFIG_ENABLE_CHIP=y
CONFIG_CHIP_ENABLE_WIFI=y
CONFIG_CHIP_ENABLE_THREAD=y
CONFIG_MQTT_PROTOCOL_SUPPORT=y
CONFIG_MQTT_TRANSPORT_SSL=n  # Enable if you want SSL
CONFIG_MQTT_USE_CUSTOM_CONFIG=n
CONFIG_BT_ENABLED=y

# Custom application-level feature toggles
CONFIG_APP_WIFI_SUPPORT=y
CONFIG_APP_WEB_UI_SUPPORT=y
CONFIG_APP_ZIGBEE_SUPPORT=n
```
